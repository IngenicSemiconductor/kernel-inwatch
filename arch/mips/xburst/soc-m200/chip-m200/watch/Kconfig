## arch/mips/xburst/soc-m200/chip-m200/watch/Kconfig
```kconfig
choice
	prompt "BOARD type"
	depends on BOARD_WATCH
	default WATCH_NEWTON2


config WATCH_NEWTON2
       bool "watch newton2"
       depends on BOARD_WATCH

config WATCH_AW808
       bool "watch aw808"
       depends on BOARD_WATCH

config WATCH_ACRAB
       bool "watch acrab"
       depends on BOARD_WATCH

config WATCH_SOLAR
       bool "watch solar"
       depends on BOARD_WATCH
endchoice

if WATCH_AW808
source "arch/mips/xburst/soc-m200/chip-m200/watch/aw808/Kconfig"
endif
if WATCH_SOLAR
source "arch/mips/xburst/soc-m200/chip-m200/watch/solar/Kconfig"
endif

config BOARD_NAME
	string "BOARD_NAME"
	default "newton2" if WATCH_NEWTON2
	default "aw808" if WATCH_AW808
	default "acrab" if WATCH_ACRAB
	default "solar" if WATCH_SOLAR

config ROOTLIST
	bool "Export hardware information to proc/hardware/list"
    default y
	help
      Export hardware information to proc/hardware/list,
      When boot on Android then read this file and configure system

config BLUETOOTH_NAME
	string  "export bluetooth chip name"
    depends on ROOTLIST
    help
      Export bluetooth chip name information to proc/hardware/list,
      format : bluetooth.chip:bcm20710

config DEVICE_VENDOR_NAME
	string  "export device vendor name"
	depends on ROOTLIST
	default "ingenic"
	help
      Export bluetooth chip name information to proc/hardware/list,
      format : system.vendor:aw808
```

## arch/mips/xburst/soc-m200/chip-m200/watch/solar/Kconfig
```kconfig
choice
	prompt "Select hardware version"
	depends on WATCH_SOLAR
	default SOLAR_HW_V10

config SOLAR_HW_V10
       bool "solar hardware version v1.0"
       depends on WATCH_SOLAR

endchoice
```

## drivers/haptics/Kconfig
```kconfig
#
# Driver IC 2605 to control motor
#

config HAPTICS_DRV2605
    bool "Driver IC 2605 to control motor"
    depends on I2C=y
    default n
    select REGMAP_I2C
    help
        Say yes here to provide support for motor driver IC 2605

if HAPTICS_DRV2605
choice
    prompt "motor types"
    depends on HAPTICS_DRV2605
    default HAPTICS_LRA_SEMCO1030
config HAPTICS_LRA_SEMCO1030
    bool "HAPTICS_LRA_SEMCO1030"

config HAPTICS_ERM_EVOWAVE_Z4TJGB1512658
    bool "HAPTICS_ERM_EVOWAVE_Z4TJGB1512658"

endchoice
endif
```

## drivers/input/misc/mma955xl/Kconfig
```kconfig
config SENSORS_MMA955XL_I2C
        tristate "Freescale MMA955XL smart sensor  driver"
        depends on I2C
        default n

config SENSORS_MMA955XL_SPI
        tristate "Freescale MMA955XL smart sensor  driver"
        depends on SPI
        default n
```

## drivers/input/touchscreen/msg22s/Kconfig
```kconfig
#
# Touchscreen driver msg22s configuration
#

config TOUCHSCREEN_MSG22S
       tristate "Touchscreen msg22s"
       depends on I2C && M200_SUPPORT_TSC
       default n
       help
       use for weilaihuawen board

if TOUCHSCREEN_MSG22S

config MSG22S_EXT_FUNC
	 bool "msg22s extra function"
	 depends on TOUCHSCREEN_MSG22S
	 default n
	 help
		the msg22s type IC extra function:
		l.open debug log
		2.tp firmware upgrade control

if MSG22S_EXT_FUNC

config UPDATE_FIRMWARE_BY_SW_ID
	 bool "msg22s auto upgrade"
	 depends on MSG22S_EXT_FUNC
	 default n
	 help
	 1.the msg22s type IC auto upgrade as your version large than the older
	 2.you can echo the file which is xxx.bin(the path should be completed) to the sysfs interface to update the firmware.

config ENABLE_TOUCH_DRIVER_DEBUG
	 bool "msg22s debug by print the log"
	 depends on MSG22S_EXT_FUNC
	 default n
	 help
	 The below compile option is used to enable the output log mechanism while touch device driver is running.
	 If this compile option is not defined, the function for output log will be disabled.
	 see the mstar_drv_common.h explain.

config ENABLE_FIRMWARE_DATA_LOG
	 bool "msg22s firmware debug by print the log"
	 depends on MSG22S_EXT_FUNC
	 default n
	 help
	 The below compile option is used to enable debug mode data log for firmware.
	 Please make sure firmware support debug mode data log first, then you can enable this compile option.
	 Else, please disbale this compile option.
	 the firmware may not be support debug mode to print the data log, if it not support, i2c may be print error. but it don't matter for us to use the tp.
	 see the mstar_drv_common.h explain.


endif
endif
```

## drivers/slpt/Kconfig
```kconfig
menu "Slpt Drivers"

config SLPT
	bool "slpt driver"
	help

config FB_DISPLAY_ALWAYS_ON
	bool "FB_DISPLAY_ALWAYS_ON"
	depends on FB_JZ_V12
	default n

config LCD_BRIGHTNESS_ALWAYS_ON
	bool "LCD_BRIGHTNESS_ALWAYS_ON"
	default n
	depends on BACKLIGHT_CLASS_DEVICE
	help
	  Say Y if you do not want to keep lcd brightness always on.

config LCD_BRIGHTNESS_ALWAYS_ON_LEVEL
	int "LCD_BRIGHTNESS_ALWAYS_ON_LEVEL"
	default 102
	depends on LCD_BRIGHTNESS_ALWAYS_ON
	help
	  The lowest level of brightness (threshold brightness level), when LCD_BRIGHTNESS_ALWAYS_ON is selected.
	  The default value 102 is assume the max brightness is 255.

config SLPT_MAP_TO_KSEG2
	bool "slpt will map to kseg2 address"
	depends on SLPT
	default y

config SLPT_BUILT_IN_FIRMWARE
	bool "slpt app will built-in kernel"
	depends on SLPT
	default y

config SLPT_SHUTDOWN
    bool "entry slpt mode when system low-power shutdown"
    default n
    depends on SLPT
    help
      entry slpt mode when system low-power shutdown

config SLPT_POWERDOWN_DEVICE
    bool "Power down some device when entry slpt mode"
    default n
    depends on SLPT
    help
	  In order to equipment used for longer time
	  We will shut down some devices

config SLPT_LOW_BATTERY_VOLTAGE
	int "low battery voltage(mV) value for slpt"
	default 3624
	depends on SLPT

config SLPT_LOW_BATTERY_WARN_VOLTAGE
	int "low battery warn voltage(mV) value for slpt"
	default 3408
	depends on SLPT

config SLPT_CHARGER_GPIO
	int "charger gpio for slpt"
	default -1
	depends on SLPT

config SLPT_CHARGER_LEVEL
	int "charger gpio valid level for slpt"
	default -1
	depends on SLPT

endmenu
```

## sound/soc/ingenic/Kconfig
```kconfig
menuconfig SND_ASOC_INGENIC
	tristate "ASoC support for Ingenic"
	depends on JZRISC && SND_SOC
	help
		Say 'Y' to enable Alsa drivers of xburst.

if SND_ASOC_INGENIC

config SND_ASOC_JZ_AIC
	tristate

config SND_ASOC_JZ_AIC_SPDIF
        tristate
	select SND_ASOC_JZ_AIC

config SND_ASOC_JZ_AIC_I2S
	tristate
	select SND_ASOC_JZ_AIC
config SND_ASOC_JZ_DUMP_CDC
	tristate

config SND_ASOC_JZ_PCM
	tristate
	select SND_ASOC_JZ_DUMP_CDC

config SND_ASOC_JZ_ICDC_D1
	tristate
	select SND_ASOC_JZ_AIC
choice
	prompt "Ingenic asoc sound card select"

config SND_ASOC_INGENIC_DORADO_ICDC
	tristate "Audio support for dorado"
	depends on SOC_M200
	select SND_ASOC_JZ_AIC_I2S
	select SND_ASOC_JZ_ICDC_D1
	select SND_ASOC_JZ_PCM
	help
	  Say Y if you want to add audio support for M200 Dorado
	  reference board with internal codec
config SND_ASOC_INGENIC_NEWTON_ICDC
	tristate "Audio support for newton"
	depends on SOC_M200
	select SND_ASOC_JZ_AIC_I2S
	select SND_ASOC_JZ_ICDC_D1
	select JZ_ASOC_CODEC_HP_INSERT_REV
	select SND_ASOC_JZ_PCM
	help
	  Say Y if you want to add audio support for M200 Newton
	  reference board with internal codec
config SND_ASOC_INGENIC_WATCH_ICDC
	tristate "Audio support for watch"
	depends on SOC_M200
	select SND_ASOC_JZ_AIC_I2S
	select SND_ASOC_JZ_ICDC_D1
	select SND_ASOC_JZ_PCM
	help
	  Say Y if you want to add audio support for M200 Watch
	  reference board with internal codec
endchoice
config JZ_ASOC_DMA_AUTO_CLR_DRT_MEM
	bool "JZ audio dma clear auto dirty memory"
	help
	  Say Y if you audio dma clear auto dirty memory, so you would not
	  clear by slience_threshold set by user app
config JZ_ASOC_DMA_HRTIMER_MODE
	bool "JZ audio dma cyclic dma with hrtimer callback mode"
	depends on HIGH_RES_TIMERS
	default n
	help
	  Say Y if you want suport sandard cyclic dma interface, Say N, that
	  dma cyclic interface is not standard
config JZ_ASOC_CODEC_HP_INSERT_REV
	bool "JZ headphone jack detect is Reversal"
	depends on SND_ASOC_JZ_ICDC_D1
	default n
	help
	  Say Y if you headphone jack detect is Reversal
endif
```
